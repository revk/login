## Kconfig
```kconfig
menu "login system"

menu "Database"

    config DB_CONF
    	string "Database access config file"
	default ""
	help
		Specify the path of the mysql.conf file for database access

    config DB_FROM_ENV
    	bool "Expect database name in environment"
	default n
	help
		If database name is expected from an environment variable

    config DB_DATABASE
    	string "Database name"
	default ""
	depends on !DB_FROM_ENV
	help
		Fixed database name to use (may be in mysql.conf if not set here)

    config DB_USER_TABLE
    	string "User table"
	default "user"
	help
		Table for user ID and password

    config DB_USERNAME_FIELD
    	string "User login field"
	default "user"
	help
		The field name in user table for the user login name/email/etc

    config DB_PASSWORD_FIELD
    	string "User password hash field"
	default "hash"
	help
		The field name in user table for the password hash

    config DB_SEPARATE_SESSION
    	bool "Separate session table"
	default y
	help
		If a separate session table is to be used

    config DB_SESSION_TABLE
    	string "Session table"
	default "session"
	depends on DB_SEPARATE_SESSION
	help
		Table for session tracking

    config DB_SESSION_FIELD
    	string "Session cookie field"
	default "session"
	help
		Field name for session tracking cookie

    config DB_SESSION_USER_LINK
    	string "Field name in session table to link to user"
	default "user"
	depends on DB_SEPARATE_SESSION
	help
		Field name, probably foreign key, from session table to user table user id primary key

    config DB_USER_ID_FIELD
    	string "Field name in user table that is primary key linked from session table"
	default "ID"
	help
		Field name of primary key in user table

    config DB_SESSION_TIME
    	string "Field name in session table for logged in time"
	default "logintime"
	depends on DB_SEPARATE_SESSION
	help
		Field name for logged in time

    config DB_SESSION_IP
    	string "Field name in session table for logged in IP"
	default "loginip"
	depends on DB_SEPARATE_SESSION
	help
		Field name for logged in IP address varchar(39) - updated if it changes...

    config DB_SESSION_AGENT
    	string "Field name in session table for browser user agent"
	default "useragent"
	depends on DB_SEPARATE_SESSION
	help
		Field name for logged in browser user agent - updated if it changes...

    config DB_SESSION_EXPIRES
    	string "Field name in session table for expiry of current session"
	default "expires"
	depends on DB_SEPARATE_SESSION && SESSION_EXPIRY!=0
	help
		Fieldname of session expires datetime, updated periodically not on every access

    config DB_CLEANUP_SESSION
    	bool "Clean up expired sessions"
	default n
	depends on DB_SEPARATE_SESSION && SESSION_EXPIRY!=0
	help
		Do a session clean when updating any expires

    config DB_DEBUG
    	bool "Turn on database debug"
	default n
	help
		Database debug to stderr

endmenu

menu "CGI Wrapper"

    config SESSION_COOKIE
	string "Session cookie"
	default "ENVCGI"
	help
		Name of session cookie

    config SESSION_EXPIRY
    	int "Session expiry (hours)"
	default 24
	help
		Session expiry (hours), set 0 for unlimited

    config PAGE_HOME
	string "Home page"
	default "/"
	help
		Home page to which user is redirected when logged in (if not back link)

    config PAGE_LOGIN
	string "Login page"
	default "/login.cgi"
	help
		Login page to which user is redirected when not logged in

    config PAGE_PASSWORD
	string "Password page"
	default "/changepassword.cgi"
	help
		Page to which user is redirected when logged in but with no password set (e.g. new user)

    config ENV_DB_FROM_URL
    	bool "Set database environment variable from first part of URL"
	default n
	depends on DB_FROM_ENV
	help
		Sets the database environment variable based on the first part of url, e.g. https://example.com/from/stuff.cgi sets to from

    config FORM_SECURITY
    	bool "Perform security checks on forms"
	default y
	help
		Checks and sets environment variables used to provide form security (script has to check result)

    config FORM_SECURITY_AGE
    	int "How long a form remains value, in minutes"
	default 60
	depends on FORM_SECURITY
	help
		Set how long the form remains valid (in minutes)

    config FORM_SECURITY_POSTS
    	bool "Do form security on all posts - redirect on failure"
	default n
	depends on FORM_SECURITY
	help
		Stops any POST without valid form security unless allowed on individual script

    config BLOCK_GET
    	bool "Block all GET operations by default (per script usage can allow these)"
	default n
	help
		Stops any GET unless set on individual script

    config BLOCK_POST
    	bool "Block all POST operations by default (per script usage can allow these)"
	default n
	help
		Stops any POST unless set on individual script

    config WEBLINK_AGE
    	int "How long a weblink remains active, in hours"
	default 8
	help
		Default age for web link check, in hours.

    config FORM_SECURITY_TAG
    	string "The field name for form security (does not normally need changing)"
	default "*"
	depends on FORM_SECURITY
	help
		This is a deliberately obscure form field name to avoid any clashes.

    config CGI_PATH
    	string "Fixed path under which to run CGI, colon separated"
	default "../login:../login/SQLlib:/usr/local/bin:/bin:/usr/bin:/usr/local/mysql/bin"
	help
		Force a specific PATH for CGI scripts

    config HTTP_AUTH
    	bool "Allow http authorisation"
	default n
	help
		Allow http authorisation page by page login, e.g. for use with curl

    config ERROR_WRAP
    	bool "Log http error output in timestamped error log"
	default y
	help
		Error output from login tool cgi scripts is collected as one timestamped error log output
		This happens anyway if local files made

    config LINE_TIMESTAMP
    	bool "Per line timestamp on error wrap"
	default y
	depends on ERROR_WRAP
	help
		Each line, or lines written together, get a timestamp within the wrapped error log output


endmenu

menu "Environment"

    config ENV_DB
    	string "Database environment variable"
	default "DB"
	help
		Name of database environment variable

    config ENV_SESSION
	string "Session environment variable"
	default "ENVCGI"
	help
		Name of session environment variable

    config ENV_USER_ID
    	string "Environment variable for logged in user ID"
	default "USER_ID"
	help
		Users unique ID from user table for logged in user

    config ENV_USERNAME
    	string "The environment variable for username when logging in"
	default "USERNAME"
	help
		Field name to use in a form for username in login

    config ENV_USER_PREFIX
    	string "Prefix for user table fields loaded in to environment"
	default "USER_"
	help
		When loading fields from user table, prefix with this

    config ENV_USER_UPPER_CASE
    	bool "Convert field names to upper case when loading from user table"
	default y
	help
		When loading fields from user table, make them upper case

    config ENV_USER_LOAD
    	bool "Load all fields in user table to environment when logged in"
	default n
	help
		If set, all fields (except password hash) are put in environment when logged in

    config ENV_USER_FIELD_LIST
    	string "Only load specific fields from user table (comma separated list)"
	default ""
	depends on !ENV_USER_LOAD
	help
		If not empty then only specified fields are loaded

    config ENV_USER_FIELD_EXCLUDE
    	string "Don't load specific fields from user table (comma separated list)"
	default ""
	depends on ENV_USER_LOAD
	help
		List the fields not to load in to environment when logged in (password has automatically excluded)

    config ENV_SESSION_PREFIX
    	string "Prefix for session table fields loaded in to environment"
	default "SESSION_"
	depends on DB_SEPARATE_SESSION
	help
		When loading fields from session table, prefix with this

    config ENV_SESSION_UPPER_CASE
    	bool "Convert field names to upper case when loading from session table"
	default y
	depends on DB_SEPARATE_SESSION
	help
		When loading fields from session table, make them upper case

    config ENV_SESSION_LOAD
    	bool "Load all fields in session table to environment when logged in"
	default y
	depends on DB_SEPARATE_SESSION
	help
		If set, all fields (some excluded) are put in environment when logged in

    config ENV_SESSION_FIELD_LIST
    	string "Only load specific fields from session table (comma separated list)"
	default ""
	depends on !ENV_SESSION_LOAD && DB_SEPARATE_SESSION
	help
		If not empty then only specified fields are loaded

    config ENV_SESSION_FIELD_EXCLUDE
    	string "Don't load specific fields from session table (comma separated list)"
	default ""
	depends on ENV_SESSION_LOAD && DB_SEPARATE_SESSION
	help
		List the fields not to load in to environment when logged in (some automatically excluded)

    config ENV_PASSWORD
    	string "The environment variable for password when logging in"
	default "PASSWORD"
	help
		Field name to use in a form for password in login

    config ENV_OLD_PASSWORD
    	string "The environment variable for old password when changing password"
	default "OLDPASSWORD"
	help
		Field name to use in a form for old password in change password

    config ENV_NEW_PASSWORD
    	string "The environment variable for new password when changing password"
	default "NEWPASSWORD"
	help
		Field name to use in a form for new password in change password

    config ENV_BACK
	string "Back link environment variable"
	default "BACK"
	help
		Form variable included when redirecting to login page to allow return to requested page (if was a GET)

    config ENV_FAIL
	string "Fail link environment variable"
	default "MSG"
	help
		Form variable included when redirecting to login page to show an error on the page

    config ENV_SECURITY
    	string "Environment / form field name used for checking form security"
	default "*"
	help
		Used by secureform command

    config ENVCGI_SERVER
    	string "Environment variable to set for simplified server name"
	default "ENVCGI_SERVER"
	help
		Extracted server name from apache variables

    config ENVCGI_SCRIPT
    	string "Environment variable to set for simplified server name"
	default "ENVCGI_SCRIPT"
	help
		Extracted script name from apache variables

    config ENVCGI_DIRECTORY
    	string "Environment variable to set for simplified server name"
	default "ENVCGI_DIRECTORY"
	help
		Extracted director name from apache variables

    config ENVCGI_QUERY
    	string "Environment variable to set for simplified server name"
	default "ENVCGI_QUERY"
	help
		Extracted query name from apache variables

    config ENV_FORM_SECURITY_NAME
    	string "Environment variable holding the field name to use for form security"
	default ""
	depends on FORM_SECURITY
	help
		Use the content of this variable as the name for a hidden field in any form you make. Holds FORM_SECURITY_NAME

    config ENV_FORM_SECURITY_OK
    	string "Environment variable that is only set if the form security passed"
	default "SECURITY_OK"
	depends on FORM_SECURITY
	help
		If a form security check passed, this is set. Otherwise it is unset.

    config ENV_FORM_SECURITY_VALUE
    	string "Environment variable holding the field value to use for form security"
	default ""
	depends on FORM_SECURITY
	help
		Use the content of this variable as the value for a hidden field in any form you make - default is FORM_SECURITY_NAME

    config ENV_RELAY_ADDR
    	string "Environment variable set if relayed via proxy"
	default "RELAY_ADDR"
	help
		When using a proxy, we set the original IP/Host if same /48 IPv6, and set this variable as original IP

    config ENV_HTTP_BAD_REFERER
    	string "Environment variable set if there seems to be a bad referrer"
	default "HTTP_BAD_REFERER"
	help
		Set if referrer not same domain / subdomain.

endmenu

menu "Passwords"

    config PASSWORD_MIN
    	int "Min password length"
	default 8
	help
		Default minimum password length

    config PASSWORD_MAX
    	int "Max password length"
	default 32
	help
		Default maximum password length

    config PASSWORD_ENTROPY
    	int "Min password entropy"
	default 40
	help
		Default minimum password entropy

    config PASSWORD_UPDATE
    	bool "Update to latest hash on login"
	default y
	help
		Update hash to latest hash on successful login

    config PASSWORD_ARGON2
    	bool "Accept Argon2 hash"
	default y
	help
		Accept Argon2 hashes

    config PASSWORD_SHA256
    	bool "Accept SHA256 hash"
	default y
	help
		Accept SHA256 hashes

    config PASSWORD_SHA1
    	bool "Accept SHA1 hash"
	default y
	help
		Accept SHA1 hashes

    config PASSWORD_MD5
    	bool "Accept MD5 hash"
	default y
	help
		Accept MD5 hashes

    config PASSWORD_MYSQL
    	bool "Accept mysql hash"
	default y
	help
		Accept mysql hashes

    config PASSWORD_OLDMYSQL
    	bool "Accept very old mysql hash"
	default n
	help
		Accept the very insure very old mysql password hashes

    config PASSWORD_DELAY
    	bool "Delay for failed password - system wide lockout"
	default y
	help
		System wide delay on password fail

endmenu

endmenu
```
